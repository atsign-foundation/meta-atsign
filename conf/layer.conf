## conf/layer.conf
```bitbake
# We have a conf and classes directory, add to BBPATH
BBPATH .= ":${LAYERDIR}"

# We have recipes-* directories, add to BBFILES
BBFILES += "${LAYERDIR}/recipes-*/*/*.bb \
            ${LAYERDIR}/recipes-*/*/*.bbappend"

BBFILE_COLLECTIONS += "meta-atsign"
BBFILE_PATTERN_meta-atsign = "^${LAYERDIR}/"
BBFILE_PRIORITY_meta-atsign = "6"

LAYERDEPENDS_meta-atsign = "core"
LAYERSERIES_COMPAT_meta-atsign = "scarthgap"
```
